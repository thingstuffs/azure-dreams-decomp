_gp = 0x80080994;
D_80083160 = 0x80083160;
func_800644B8 = 0x800644B8;
func_80064584 = 0x80064584;
func_8006658C = 0x8006658C;
func_8006671C = 0x8006671C;
SECTIONS { . = 0x80157964; .text ALIGN(4) : SUBALIGN(4) { *(.text.func_801750E4) } }
