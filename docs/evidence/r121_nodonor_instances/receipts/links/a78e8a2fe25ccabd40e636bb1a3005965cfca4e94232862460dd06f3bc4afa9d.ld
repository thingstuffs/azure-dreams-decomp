_gp = 0x80080994;
D_8006CCD8 = 0x8006CCD8;
D_8006CCE8 = 0x8006CCE8;
D_80083160 = 0x80083160;
D_800EA000 = 0x800EA000;
func_800A07D0 = 0x800A07D0;
func_800A6D30 = 0x800A6D30;
SECTIONS { . = 0x8001C5E4; .text ALIGN(4) : SUBALIGN(4) { *(.text.func_8001C5E4) } }
