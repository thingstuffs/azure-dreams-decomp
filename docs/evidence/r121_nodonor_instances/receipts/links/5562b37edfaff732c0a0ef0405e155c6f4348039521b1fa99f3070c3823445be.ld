_gp = 0x80080994;
D_8001F660 = 0x8001F660;
D_8001F664 = 0x8001F664;
D_8001F66C = 0x8001F66C;
D_8001F6A0 = 0x8001F6A0;
D_8001F6A4 = 0x8001F6A4;
D_8001F6E8 = 0x8001F6E8;
D_8006CCD8 = 0x8006CCD8;
D_8006CCE8 = 0x8006CCE8;
func_8001ABC8 = 0x8001ABC8;
func_800A6D30 = 0x800A6D30;
SECTIONS { . = 0x8001A768; .text ALIGN(4) : SUBALIGN(4) { *(.text.func_8001A768) } }
