_gp = 0x80080994;
D_80080000 = 0x80080000;
D_800DCECC = 0x800DCECC;
func_800478B8 = 0x800478B8;
func_80065420 = 0x80065420;
SECTIONS { . = 0x80159020; .text ALIGN(4) : SUBALIGN(4) { *(.text.func_80171020) } }
