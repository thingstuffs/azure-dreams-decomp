_gp = 0x80080994;
D_80012D60 = 0x80012D60;
D_80080A80 = 0x80080A80;
D_80080A90 = 0x80080A90;
D_80080AE0 = 0x80080AE0;
D_80080AE8 = 0x80080AE8;
D_80080E18 = 0x80080E18;
D_80080E20 = 0x80080E20;
D_80080E30 = 0x80080E30;
D_80080EE8 = 0x80080EE8;
D_80081468 = 0x80081468;
D_80082E6B = 0x80082E6B;
D_80083460 = 0x80083460;
D_800DCE68 = 0x800DCE68;
D_800DCF4F = 0x800DCF4F;
D_800DCF58 = 0x800DCF58;
D_800DCF5B = 0x800DCF5B;
D_800E296C = 0x800E296C;
D_800E3548 = 0x800E3548;
D_800E36C8 = 0x800E36C8;
D_800E3CCC = 0x800E3CCC;
D_800E3CCE = 0x800E3CCE;
D_800E3D70 = 0x800E3D70;
D_800E3E40 = 0x800E3E40;
D_8014A000 = 0x8014A000;
bzero = 0x80069EC8;
func_80041284 = 0x80041284;
func_80048D00 = 0x80048D00;
SECTIONS { . = 0x8001625C; .text ALIGN(4) : SUBALIGN(4) { *(.text.func_8001625C) } }
