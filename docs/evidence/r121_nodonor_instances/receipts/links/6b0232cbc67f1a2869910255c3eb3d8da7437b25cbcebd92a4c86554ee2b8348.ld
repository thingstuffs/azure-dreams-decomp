_gp = 0x80080994;
D_800D68F4 = 0x800D68F4;
D_800D707C = 0x800D707C;
D_800E2468 = 0x800E2468;
func_8003FD64 = 0x8003FD64;
func_8004491C = 0x8004491C;
rand = 0x80069EF8;
SECTIONS { . = 0x801591DC; .text ALIGN(4) : SUBALIGN(4) { *(.text.func_801711DC) } }
