_gp = 0x80080994;
func_8003FD64 = 0x8003FD64;
func_8004491C = 0x8004491C;
func_80170884 = 0x80170884;
func_80170A64 = 0x80170A64;
SECTIONS { . = 0x80170D28; .text ALIGN(4) : SUBALIGN(4) { *(.text.func_80170D28) } }
