_gp = 0x80080994;
D_800814A0 = 0x800814A0;
func_800478B8 = 0x800478B8;
func_800A45D8 = 0x800A45D8;
func_800BCB04 = 0x800BCB04;
SECTIONS { . = 0x80164D34; .text ALIGN(4) : SUBALIGN(4) { *(.text.func_80170D34) } }
